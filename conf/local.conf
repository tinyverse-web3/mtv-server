## conf/local.conf
```bitbake
appname = mtv
httpaddr = "192.168.3.68"
httpport = 6060

EnableHTTP = true
EnableDocs = true
EnableHTTPS = true
EnableHttpTLS = true
HttpsPort = 6063
HTTPSCertFile = "conf/ssl.crt"
HTTPSKeyFile = "conf/ssl.key"

copyrequestbody = true
# sessionon = true
# sessiongcmaxlifetime = 86400 # 设置Session有效期，单位秒

lang_types = en-US|zh-CN

[mail]
# host = "smtp.qq.com"
# port = "25"
# userName = "45744453@qq.com"
# password = "tqjiinyatjppcagb"
host = "smtp.exmail.qq.com"
port = "465"
userName = "wudujuan@tinyverse.space"
password = "To40yept"
# host = "smtp.gmail.com"
# host = "587"
# userName = "duyouyou88@gmail.com"
# password = "to40yept"

[mysql]
dbdebug = true
dbalias = default
dbdriver = mysql
dbhost = 127.0.0.1
dbport = 3306
dbuser = root
dbpassword = 1qazXSW@
dbname = mtv
dbprefix = ""
dbcharset = utf8mb4
dbloc = Local
maxIdleConns = 1000
maxOpenConns = 2000

[redis]
address = localhost:6379
database = 0
password = ""
key = "mtv"
```
